## CMakeLists.txt
```
cmake_minimum_required(VERSION 3.20.0)
find_package(Zephyr REQUIRED HINTS $ENV{ZEPHYR_BASE})
project(app_lorawan_stub)

target_sources(app PRIVATE
  src/main.c
  src/lorawan_config.c
  src/payload_crypto.c
)
```

## prj.conf
```kconfig
CONFIG_LOG=y
CONFIG_LOG_DEFAULT_LEVEL=3
CONFIG_MAIN_STACK_SIZE=4096

CONFIG_CBPRINTF_COMPLETE=y
CONFIG_CBPRINTF_FP_SUPPORT=y

# --- mbedTLS for HMAC-SHA256 ---
CONFIG_MBEDTLS=y
CONFIG_MBEDTLS_BUILTIN=y
CONFIG_MBEDTLS_ENABLE_HEAP=y
CONFIG_MBEDTLS_HEAP_SIZE=8192

# Zephyr 4.3: MD -> MD_C
CONFIG_MBEDTLS_MD_C=y

# SHA256 algorithm (no _C)
CONFIG_MBEDTLS_SHA256=y
```

## src/main.c
```c
#include <zephyr/kernel.h>
#include <zephyr/logging/log.h>
#include <zephyr/random/random.h>
#include <stdio.h>

#include "lorawan_config.h"
#include "payload_crypto.h"

LOG_MODULE_REGISTER(app, LOG_LEVEL_INF);

static float rand_float_1dp(float min_v, float max_v)
{
    uint32_t r = sys_rand32_get();
    float t = (float)r / (float)UINT32_MAX;
    float v = min_v + t * (max_v - min_v);

    int32_t scaled = (int32_t)(v * 10.0f + (v >= 0 ? 0.5f : -0.5f));
    return (float)scaled / 10.0f;
}

static void lorawan_send_stub(uint8_t fport, const char *payload, bool confirmed)
{
    LOG_INF("SEND (stub): fport=%d confirmed=%d payload=\"%s\"",
            fport, confirmed ? 1 : 0, payload);
}

int main(void)
{
    LOG_INF("App started (QEMU).");
    lorawan_config_dump();

    const uint8_t fport = LORAWAN_FPORT;
    const bool confirmed = (LORAWAN_CONFIRMED_UPLINK != 0);

    while (1) {
        float temp = rand_float_1dp(-10.0f, 40.0f);
        float hum  = rand_float_1dp(20.0f, 90.0f);

        char payload_plain[64];
        char hmac_hex[65];
        char payload_signed[140];

        snprintf(payload_plain, sizeof(payload_plain),
                 "T:%.1f,H:%.1f", (double)temp, (double)hum);

        payload_hmac_sha256_hex(payload_plain, hmac_hex, sizeof(hmac_hex));

        snprintf(payload_signed, sizeof(payload_signed),
                 "%s#%s", payload_plain, hmac_hex);

        LOG_INF("Sensor mock: T=%.1f C, H=%.1f %%", (double)temp, (double)hum);
        LOG_INF("Payload plain : %s", payload_plain);
        LOG_INF("Payload signed: %s", payload_signed);

        lorawan_send_stub(fport, payload_signed, confirmed);

        k_sleep(K_SECONDS(TX_INTERVAL_SECONDS));
    }

    return 0;
}
```

## src/lorawan_config.c
```c
#include <zephyr/logging/log.h>
#include <zephyr/sys/util.h>
#include <stdio.h>

#include "lorawan_config.h"

LOG_MODULE_REGISTER(lora_cfg, LOG_LEVEL_INF);

static void print_hex(const char *label, const uint8_t *buf, size_t len)
{
    char out[128];
    size_t pos = 0;

    for (size_t i = 0; i < len; i++) {
        if (pos + 2 >= sizeof(out)) {
            break;
        }
        pos += snprintk(&out[pos], sizeof(out) - pos, "%02X", buf[i]);
    }

    out[MIN(pos, sizeof(out) - 1)] = 0;
    LOG_INF("%s: %s", label, out);
}

void lorawan_config_dump(void)
{
    LOG_INF("========== LoRaWAN CONFIG ==========");
    LOG_INF("Region           : %s", LORAWAN_REGION_STR);
    LOG_INF("Class            : %s", LORAWAN_CLASS_STR);
    LOG_INF("LoRaWAN Version  : %s", LORAWAN_VERSION_STR);

    LOG_INF("FPort            : %d", LORAWAN_FPORT);
    LOG_INF("Confirmed Uplink : %d", LORAWAN_CONFIRMED_UPLINK);
    LOG_INF("ADR Enabled      : %d", LORAWAN_ADR_ENABLED);

    LOG_INF("TX Interval (s)  : %d", TX_INTERVAL_SECONDS);

    print_hex("DevEUI",  DEV_EUI,  sizeof(DEV_EUI));
    print_hex("JoinEUI", JOIN_EUI, sizeof(JOIN_EUI));
    print_hex("AppKey",  APP_KEY,  sizeof(APP_KEY));

    LOG_INF("===================================");
}
```

## src/lorawan_config.h
```c
#pragma once
#include <stdint.h>
#include <stdbool.h>

#ifdef __cplusplus
extern "C" {
#endif

/* ========== LoRaWAN Configuration (from specification) ========== */

/* General */
#define LORAWAN_REGION_STR          "EU868"
#define LORAWAN_CLASS_STR           "A"
#define LORAWAN_VERSION_STR         "1.0.3"

/* Uplink settings */
#define LORAWAN_FPORT               1
#define LORAWAN_CONFIRMED_UPLINK    1
#define LORAWAN_ADR_ENABLED         1

/* Transmission interval
 * QEMU test value: 10 seconds
 * Real device value: 600 seconds
 */
#define TX_INTERVAL_SECONDS         10

/* OTAA credentials (PLACEHOLDER)
 * Fill real values when moving to real hardware
 */
static const uint8_t DEV_EUI[8]  = {
    0x00,0x00,0x00,0x00,0x00,0x00,0x00,0x00
};

static const uint8_t JOIN_EUI[8] = {
    0x00,0x00,0x00,0x00,0x00,0x00,0x00,0x00
};

static const uint8_t APP_KEY[16] = {
    0x00,0x00,0x00,0x00,0x00,0x00,0x00,0x00,
    0x00,0x00,0x00,0x00,0x00,0x00,0x00,0x00
};

/* Print configuration to log */
void lorawan_config_dump(void);

#ifdef __cplusplus
}
#endif
```

## src/payload_crypto.c
```c
#include <string.h>
#include <stdio.h>

#include <zephyr/logging/log.h>
#include <mbedtls/md.h>

#include "payload_crypto.h"

/* Payload signing secret (NOT LoRaWAN AppKey) */
static const unsigned char PAYLOAD_SECRET[] = "PAYLOAD_HMAC_SECRET_123";

LOG_MODULE_REGISTER(payload_crypto, LOG_LEVEL_INF);

void payload_hmac_sha256_hex(const char *input, char *out_hex, size_t out_size)
{
    unsigned char hmac[32];
    const mbedtls_md_info_t *md_info;

    if (!input || !out_hex || out_size < 65) {
        return;
    }

    md_info = mbedtls_md_info_from_type(MBEDTLS_MD_SHA256);
    if (md_info == NULL) {
        return;
    }

    /* HMAC-SHA256 */
    if (mbedtls_md_hmac(md_info,
                        PAYLOAD_SECRET, strlen((const char *)PAYLOAD_SECRET),
                        (const unsigned char *)input, strlen(input),
                        hmac) != 0) {
        return;
    }

    /* to hex (64 chars) */
    for (int i = 0; i < 32; i++) {
        snprintf(&out_hex[i * 2], out_size - (i * 2), "%02x", hmac[i]);
    }
    out_hex[64] = '\0';
}
```

## src/payload_crypto.h
```c
#pragma once
#include <stddef.h>

#ifdef __cplusplus
extern "C" {
#endif

/* Compute HMAC-SHA256 of input string and return hex string (64 chars) */
void payload_hmac_sha256_hex(const char *input, char *out_hex, size_t out_size);

#ifdef __cplusplus
}
#endif
```
